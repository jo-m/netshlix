## components/rtpjpeg/Kconfig.projbuild
```kconfig
menu "RTP/JPEG"

    config RTP_JITBUF_CAP_N_PACKETS
        prompt "RTP jitterbuffer capacity number of packets"
        int
        default 15

    config RTP_JITBUF_CAP_PACKET_SIZE_BYTES
        prompt "RTP jitterbuffer capacity size per RTP packet"
        int
        default 1400
        help
            Should be equal to expected RTP packet/UDP payload size (gst rtpjpegpay mtu).

    menu "JPEG"

        config RTP_JPEG_MAX_DATA_SIZE_BYTES
            prompt "Max allowed JPEG frame size"
            int
            default 20480

    endmenu

endmenu
```

## components/tjpgd/Kconfig.projbuild
```kconfig
menu "TJpgDec"

    config JD_SZBUF
        int "Specifies size of stream input buffer."
        default 512
        range 0 51200
        help
            See JD_SZBUF in tjpgdcnd.h.

    config JD_FORMAT
        int "Specifies output pixel format."
        default 0
        range 0 2
        help
            See JD_FORMAT in tjpgdcnd.h.

    config JD_USE_SCALE
        int "Switches output descaling feature."
        default 1
        range 0 1
        help
            See JD_USE_SCALE in tjpgdcnd.h.

    config JD_TBLCLIP
        int "Use table conversion for saturation arithmetic."
        default 1
        range 0 1
        help
            See JD_TBLCLIP in tjpgdcnd.h.

    config JD_FASTDECODE
        int "Optimization level"
        default 0
        range 0 2
        help
            See JD_FASTDECODE in tjpgdcnd.h.

endmenu
```

## main/Kconfig.projbuild
```kconfig
menu "Smalltv Main App Configuration"

    menu "WIFI"

        config SMALLTV_WIFI_SSID
            string "WiFi SSID"
            default "myssid"
            help
                SSID (network name) for the example to connect to.

        config SMALLTV_WIFI_PASSWORD
            string "WiFi Password"
            default "mypassword"
            help
                WiFi password (WPA or WPA2) for the example to use.

        config SMALLTV_WIFI_MAXIMUM_RETRY
            int "Maximum retry"
            default 5
            help
                Set the max retry to avoid station reconnecting to the AP unlimited when the AP is really inexistent.

    endmenu

    menu "mDNS"

        config SMALLTV_MDNS_HOSTNAME
            string "mDNS Hostname"
            default "smalltv"
            help
                mDNS Hostname

        config SMALLTV_MDNS_INSTANCE
            string "mDNS Instance Name"
            default "smalltv instance"
            help
                mDNS Instance Name
    endmenu

    menu "RTP"

        config SMALLTV_RTP_PORT
            int "Port"
            range 0 65535
            default 1234
            help
                Local UDP port the RTP server will listen on.

        config SMALLTV_UDP_MTU_BYTES
            int "UDP MTU Bytes"
            range 1 65535
            default 1400
            help
                MTU to assume for UDP packets, will be used to set receive buffer size.

        config SMALLTV_UDP_RECV_TIMEOUT_S
            int "Receive timeout seconds"
            range 0 10
            default 2

    endmenu

endmenu
```

## sdkconfig.defaults.ci
```kconfig
# Config used in CI runs.

# WiFi AP to connect to
CONFIG_SMALLTV_WIFI_SSID="my-amazing-ssid"
CONFIG_SMALLTV_WIFI_PASSWORD="my-amazing-key"

# System
CONFIG_FREERTOS_HZ=1000
CONFIG_APP_REPRODUCIBLE_BUILD=y
CONFIG_APP_RETRIEVE_LEN_ELF_SHA=16
CONFIG_COMPILER_OPTIMIZATION_PERF=y
CONFIG_COMPILER_STACK_CHECK_MODE_STRONG=y
CONFIG_COMPILER_WARN_WRITE_STRINGS=y
CONFIG_ESP_DEFAULT_CPU_FREQ_MHZ_240=y
CONFIG_ESP_MAIN_TASK_STACK_SIZE=4096
CONFIG_ESPTOOLPY_FLASHSIZE_8MB=y
CONFIG_PARTITION_TABLE_CUSTOM=y

# WiFi RX
CONFIG_ESP_WIFI_STATIC_RX_BUFFER_NUM=4
CONFIG_ESP_WIFI_DYNAMIC_RX_BUFFER_NUM=8
CONFIG_ESP_WIFI_STATIC_RX_MGMT_BUFFER=y
CONFIG_ESP_WIFI_AMPDU_RX_ENABLED=n

# WiFi TX
CONFIG_ESP_WIFI_STATIC_TX_BUFFER=y
CONFIG_ESP_WIFI_STATIC_TX_BUFFER_NUM=8
CONFIG_ESP_WIFI_AMPDU_TX_ENABLED=n
CONFIG_ESP_WIFI_AMSDU_TX_ENABLED=n

# LWIP
CONFIG_LWIP_MAX_SOCKETS=2
CONFIG_LWIP_TCPIP_RECVMBOX_SIZE=12
CONFIG_LWIP_TCP_RECVMBOX_SIZE=6
CONFIG_LWIP_UDP_RECVMBOX_SIZE=6
CONFIG_LWIP_TCP_ACCEPTMBOX_SIZE=2
CONFIG_LWIP_IPV6=n
CONFIG_LWIP_IPV4=y
CONFIG_LWIP_NETBUF_RECVINFO=y

# LVGL
CONFIG_LV_DRAW_SW_SUPPORT_RGB565A8=n
CONFIG_LV_DRAW_SW_SUPPORT_RGB888=n
CONFIG_LV_DRAW_SW_SUPPORT_XRGB8888=n
CONFIG_LV_DRAW_SW_SUPPORT_ARGB8888=n
CONFIG_LV_DRAW_SW_SUPPORT_L8=n
CONFIG_LV_DRAW_SW_SUPPORT_AL88=n
CONFIG_LV_DRAW_SW_SUPPORT_A8=n
CONFIG_LV_DRAW_SW_SUPPORT_I1=n
CONFIG_LV_FONT_MONTSERRAT_14=n
CONFIG_LV_FONT_DEFAULT_MONTSERRAT_20=y
CONFIG_LV_USE_TJPGD=y

# Pin main to CPU1 (everything is on CPU0).
CONFIG_ESP_MAIN_TASK_AFFINITY_CPU1=y
CONFIG_ESP_MAIN_TASK_AFFINITY=1
```
